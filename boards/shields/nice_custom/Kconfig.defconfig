## boards/shields/nice_custom/Kconfig.defconfig
```kconfig
if SHIELD_NICE_CUSTOM

# LVGL display settings
config LV_Z_VDB_SIZE
    default 100

config LV_DPI_DEF
    default 161

config LV_Z_BITS_PER_PIXEL
    default 1

choice LV_COLOR_DEPTH
    default LV_COLOR_DEPTH_1
endchoice

config LV_Z_MEM_POOL_SIZE
    default 16384  

# Display work queue
choice ZMK_DISPLAY_WORK_QUEUE
    default ZMK_DISPLAY_WORK_QUEUE_DEDICATED
endchoice

# Use custom status screen
choice ZMK_DISPLAY_STATUS_SCREEN
    default ZMK_DISPLAY_STATUS_SCREEN_CUSTOM
endchoice

config ZMK_DISPLAY_STATUS_SCREEN_CUSTOM
    imply NICE_VIEW_WIDGET_STATUS

config NICE_VIEW_WIDGET_STATUS
    select LV_USE_LABEL      
    select LV_USE_IMG 
    select LV_USE_CANVAS       

# Optional: Enable WPM tracking if using WPM widget
if !ZMK_SPLIT || ZMK_SPLIT_ROLE_CENTRAL
config NICE_VIEW_WIDGET_STATUS
    select ZMK_WPM
endif

endif # SHIELD_NICE_CUSTOM
```

## boards/shields/nice_custom/Kconfig.shield
```kconfig
# Copyright (c) 2024 The ZMK Contributors
# SPDX-License-Identifier: MIT

config SHIELD_NICE_CUSTOM
    def_bool $(shields_list_contains,nice_custom)

if SHIELD_NICE_CUSTOM

# Display configuration
config ZMK_DISPLAY
    default y

config ZMK_WPM
    default y if (!ZMK_SPLIT || ZMK_SPLIT_ROLE_CENTRAL)
    default n

# Widget relay for split
rsource "../../../display/relay/Kconfig"

endif
```

## display/relay/Kconfig
```kconfig
# Copyright (c) 2024 The ZMK Contributors
# SPDX-License-Identifier: MIT

config NICE_CUSTOM_WIDGET_RELAY
    bool "Enable widget relay for split keyboards"
    depends on ZMK_SPLIT
    default y
    help
      Enable relay of widget data (layer, WPM, signal) from central to peripheral
      for synchronized display on both halves.
```
